// SPDX-License-Identifier: (GPL-2.0+ OR BSD-3-Clause)
/*
 * Copyright (c) 2026, onurbuber@engineer.com
 */

/dts-v1/;

#include <dt-bindings/usb/pd.h>
#include <dt-bindings/leds/common.h>
#include <dt-bindings/media/video-interfaces.h>
#include <dt-bindings/sound/qcom,q6dsp-lpass-ports.h>
#include "sm6225.dtsi"
#include "pm6125.dtsi"
#include "sm6225-xiaomi-common.dtsi"
#include "sm6225-xiaomi-camera.dtsi"
#include "sm6225-xiaomi-charger.dtsi"

/ {
	model = "Xiaomi Redmi Note 12 4G";
	compatible = "xiaomi,tapas", "qcom,sm6225";
	chassis-type = "handset";

	/* required for bootloader to select correct board */
	qcom,msm-id = <518 0x10000>;
	qcom,board-id = <0x20022 0>;
};
